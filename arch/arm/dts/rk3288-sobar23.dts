// SPDX-License-Identifier: GPL-2.0+ OR X11
/*
 * (C) Copyright 2016 Rockchip Electronics Co., Ltd
 */

/dts-v1/;
#include "rk3288-sobar23.dtsi"

/ {
	model = "SoBAR-23";
	compatible = "rockchip,sobar23-rk3288", "rockchip,rk3288";

	chosen {
		stdout-path = &uart2;
	};
};

