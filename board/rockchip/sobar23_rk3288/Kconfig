## board/rockchip/sobar23_rk3288/Kconfig
```kconfig
if TARGET_SOBAR23_RK3288

config SYS_BOARD
	default "sobar23_rk3288"

config SYS_VENDOR
	default "rockchip"

config SYS_CONFIG_NAME
	default "sobar23_rk3288"

config BOARD_SPECIFIC_OPTIONS # dummy
	def_bool y

endif
```
